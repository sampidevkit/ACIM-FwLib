#include "SPWM.h"
#include "MC.h"
#include "Debugger/DataVisualizer.h"
#include <math.h>

#define Ts          50e-6 // Time lay mau 50us
#define PI          3.14159265358979323846 // pi
#define SQRT_3      1.7320508075688772 // sqrt(3)
#define vdc         310
#define PART_LENGTH 400

float VU, VV, VW;

static const float Sine[PART_LENGTH]={
    0.003922, 0.019608, 0.035294, 0.050980, 0.066667, 0.082353, 0.090196,
    0.105882, 0.121569, 0.137255, 0.152941, 0.168627, 0.184314, 0.200000,
    0.215686, 0.231373, 0.247059, 0.262745, 0.278431, 0.294118, 0.309804,
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    -0.121569, -0.105882, -0.090196, -0.082353, -0.066667, -0.050980, -0.035294,
    -0.019608
};

static mc_process_fnc Callback=NULL;

static float u[PART_LENGTH];
static float v[PART_LENGTH];
static float w[PART_LENGTH];

float duty1, duty2, duty3;
int t=0;
int S1, S3, S5;

void UTIL_SaturateS16(int* const input, const int min, const int max)
{
    if(max<(*input))
    {
        *input=max;
    }
    else if(min>(*input))
    {
        *input=min;
    }
    else
    {
        /** For MISRA Compliance */
    }
}

// Three phase shift

void _Three_phase_init(const float *source, float *shifted_table, int table_size, double phase_shift)
{
    float max_val=0.0, min_val=1.0;

    for(int i=0; i<table_size; i++)
    {
        if(source[i]>max_val)
            max_val=source[i];

        if(source[i]<min_val)
            min_val=source[i];
    }

    for(int i=0; i<table_size; i++)
    {
        double normalized_val=sin(2*PI*i/table_size+phase_shift);
        shifted_table[i]=(normalized_val+1)*(max_val-min_val)/2+min_val;
    }

    // only for spwm
    for(int i=0; i<table_size; i++)
    {
        if(shifted_table[i]<0)
            shifted_table[i]=0;
    }
}

// Voltage init

void VoltageINIT(const float* source, float* u, float* v, float* w, int length)
{
    float shifted_table_2[length];
    double phase_shift_2=4*PI/3; // 2*Pi/3 la pha 3, 4*Pi/3 la pha 2
    float shifted_table_3[length];
    double phase_shift_3=2*PI/3; // 2*Pi/3 la pha 3, 4*Pi/3 la pha 2	

    _Three_phase_init(source, shifted_table_2, length, phase_shift_2);
    _Three_phase_init(source, shifted_table_3, length, phase_shift_3);

    for(int i=0; i<length; i++)
    {
        u[i]=source[i] * 10;
        v[i]=shifted_table_2[i] * 10;
        w[i]=shifted_table_3[i] * 10;
    }
}

void pwm(float duty1, float duty2, float duty3, int* DutyU, int* DutyV, int* DutyW)
{
    *DutyU=duty1/Ts*3000;
    *DutyV=duty2/Ts*3000;
    *DutyW=duty3/Ts*3000;
}

void SPWM_Init(void (*FncCb)(void*))
{
    printf("\r\n%s init: ", __FUNCTION__);
    Callback=(mc_process_fnc)FncCb;
    VoltageINIT(Sine, u, v, w, PART_LENGTH);
}

void SPWM_Process(void)
{
    if(t==400)
        t=0;

    VU=u[t];
    VV=v[t];
    VW=w[t];

    duty1=VU/10.0*Ts;
    duty2=VV/10.0*Ts;
    duty3=VW/10.0*Ts;

    pwm(duty1, duty2, duty3, &S1, &S3, &S5);

    UTIL_SaturateS16(&S1, 0, 2999);
    UTIL_SaturateS16(&S3, 0, 2999);
    UTIL_SaturateS16(&S5, 0, 2999);

    McOutputs.DutyU=S1;
    McOutputs.DutyV=S3;
    McOutputs.DutyW=S5;

    if(Callback)
        Callback(NULL);
    
    t++;
}